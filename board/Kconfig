## board/Kconfig
```kconfig
# Copyright (c) 2013 The F9 Microkernel Project. All rights reserved.
# Use of this source code is governed by a BSD-style license that can be
# found in the LICENSE file.

menu "Board"

choice
	prompt "Target Board"
	default BOARD_STM32F4DISCOVERY
	help
	  Select the target board for F9 Microkernel.

config BOARD_STM32F4DISCOVERY
	bool "STM32F4 Discovery"
	select PLATFORM_STM32F4
	help
	  STM32F4 Discovery board with STM32F407VGT6 MCU.

config BOARD_STM32F429DISCOVERY
	bool "STM32F429 Discovery"
	select PLATFORM_STM32F429
	help
	  STM32F429 Discovery board with STM32F429ZIT6 MCU and LCD.

config BOARD_STM32F429NUCLEO
	bool "STM32F429 Nucleo"
	select PLATFORM_STM32F429
	help
	  STM32F429 Nucleo board with STM32F429ZIT6 MCU.

config BOARD_B_L475E_IOT01A
	bool "B-L475E-IOT01A Discovery"
	select PLATFORM_STM32L4
	select QEMU
	help
	  STMicroelectronics B-L475E-IOT01A Discovery board with STM32L475VG MCU.
	  Includes Cortex-M4F with FPU, MPU, and full QEMU support with FPU emulation.
	  QEMU mode is automatically enabled for this board.

	  QEMU command:
	  qemu-system-arm -M b-l475e-iot01a -nographic -kernel build/b-l475e-iot01a/f9.elf

endchoice

config QEMU
	bool "QEMU emulation mode" if !BOARD_B_L475E_IOT01A
	help
	  Enable workarounds for QEMU emulation limitations:
	  - Use semihosting for console I/O (reliable in QEMU)
	  - Use synchronous UART output if UART is selected

	  Enable this when running under QEMU. Disable for real hardware
	  to get better performance.

	  Note: Automatically enabled and mandatory for B-L475E-IOT01A board.

# Hardware feature availability flags
# These control which ARM architecture tests can run based on
# platform capabilities and emulation limitations.

config HAS_PRECISE_TIMING
	bool "Cycle-accurate timing available (DWT/SysTick)"
	default !QEMU
	help
	  Enable tests that require cycle-accurate timing measurements.
	  This covers DWT cycle counter and SysTick precision timing.

	  Tests requiring this feature:
	  - FPU lazy stacking timing (requires DWT cycle counter)
	  - Interrupt latency measurement (requires SysTick precision)

	  Disabled in QEMU because timing is not cycle-accurate.


endmenu

# Platform symbols (selected by board choice)
config PLATFORM_STM32F4
	bool

config PLATFORM_STM32F429
	bool

config PLATFORM_STM32L4
	bool
```

## platform/Kconfig
```kconfig
# Copyright (c) 2013-2016,2026 The F9 Microkernel Project. All rights reserved.
# Use of this source code is governed by a BSD-style license that can be
# found in the LICENSE file.

menu "Platform"

config BITMAP_BITBAND
	bool "Generate bitmap address in bit-band region"
	default n

config FPU
	bool "Floating point support"
	default n

choice
	prompt "Standard I/O device"
	default STDIO_SEMIHOSTING if QEMU
	default STDIO_USE_DBGPORT
	help
	  Select input/output device for stdio

config STDIO_NODEV
	bool "Null device"

config STDIO_USE_DBGPORT
	bool "Debug serial IO"
	select DEBUG

config STDIO_SEMIHOSTING
	bool "ARM Semihosting (QEMU/Debugger)"
	help
	  Use ARM semihosting for console I/O via debugger interface.

	  QEMU: Requires -semihosting flag (fast, reliable)
	  Real hardware: Requires active debugger (OpenOCD/J-Link/pyOCD)
	                 VERY SLOW - only for debugging
	                 Will CRASH if no debugger attached!

endchoice

choice
	prompt "Debug serial IO uses"
	default DBGPORT_USE_USART4
	depends on STDIO_USE_DBGPORT

config DBGPORT_USE_USART1
	bool "USART1"
config DBGPORT_USE_USART2
	bool "USART2"
config DBGPORT_USE_USART3
	bool "USART3"
config DBGPORT_USE_USART4
	bool "USART4"

endchoice

if PLATFORM_STM32F4
source "platform/stm32f4/Kconfig"
endif
if PLATFORM_STM32F429
source "platform/stm32f429/Kconfig"
endif
if PLATFORM_STM32L4
source "platform/stm32l4/Kconfig"
endif

endmenu
```

## platform/Kconfig.debug
```kconfig
# Copyright (c) 2013 The F9 Microkernel Project. All rights reserved.
# Use of this source code is governed by a BSD-style license that can be
# found in the LICENSE file.

if DEBUG

choice
	prompt "Debug device"
	default DEBUG_DEV_SEMIHOSTING if STDIO_SEMIHOSTING
	default DEBUG_DEV_UART
	help
	  Select debug output device for KDB and panic messages

config DEBUG_DEV_UART
	bool "UART based implementation"
	depends on STDIO_USE_DBGPORT
	help
	  Use UART for debug output (KDB, panic messages).
	  Requires STDIO_USE_DBGPORT to be enabled.

config DEBUG_DEV_SEMIHOSTING
	bool "ARM Semihosting"
	depends on STDIO_SEMIHOSTING
	help
	  Use ARM semihosting for debug output (KDB, panic messages).
	  Only works with QEMU or active debugger connection.

config DEBUG_DEV_RAM
	bool "RAM based virtual device"
	depends on !KDB
	help
	  A simple implementation of RAM based virtual debug device.
	  Not compatible with KDB.

endchoice

config KDB_UART_INPUT
	bool "UART input for KDB (QEMU semihosting mode)"
	depends on KDB && DEBUG_DEV_SEMIHOSTING && QEMU
	default y if KDB && DEBUG_DEV_SEMIHOSTING && QEMU
	help
	  Enable USART1 receive interrupt for KDB interactive input while
	  using semihosting for debug output. Pressing '?' activates KDB.

	  This is QEMU-specific: it hard-codes BRR for the 4 MHz MSI
	  fallback clock and skips normal GPIO/USART board init.
	  Do NOT enable on real hardware.

	  Requires QEMU: -serial mon:stdio -semihosting

endif
```
